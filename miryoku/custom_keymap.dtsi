/ {
    macros {
        colcol: colcol {
            compatible = "zmk,behavior-macro";
            #binding-cells = <0>;
            bindings = <&kp COLON &kp COLON>;
            label = "COLCOL";
        };

        updir: updir {
            compatible = "zmk,behavior-macro";
            #binding-cells = <0>;
            bindings = <&none &kp DOT &kp DOT &kp FSLH>;
            label = "UPDIR";
        };
    };
};